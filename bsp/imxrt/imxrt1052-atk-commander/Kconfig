## bsp/imxrt/imxrt1052-atk-commander/Kconfig
```kconfig
mainmenu "RT-Thread Configuration"

config RTT_DIR
    string
    option env="RTT_ROOT"
    default "../../.."

config PKGS_DIR
    string
    option env="PKGS_ROOT"
    default "packages"

source "$RTT_DIR/Kconfig"
source "$PKGS_DIR/Kconfig"
source "$BSP_DIR/../libraries/Kconfig"
source "$BSP_DIR/board/Kconfig"
```
